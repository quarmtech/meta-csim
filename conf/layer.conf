## conf/layer.conf
```bitbake
# We have a conf and classes directory, add to BBPATH
BBPATH .= ":${LAYERDIR}"

# We have recipes-* directories, add to BBFILES
BBFILES += "${LAYERDIR}/recipes-*/*/*.bb \
	${LAYERDIR}/recipes-*/*/*.bbappend"

BBFILE_COLLECTIONS += "meta-csim"
BBFILE_PATTERN_meta-csim = "^${LAYERDIR}/"
BBFILE_PRIORITY_meta-csim = "9"
```

## conf/machine/psi-csim-scm.conf
```bitbake
#@TYPE: Machine
#@NAME: PSI i.MX6QSCM csim
#@SOC: i.MX6Q
#@DESCRIPTION: Machine configuration for PSI i.MX6SCM csim
#@MAINTAINER: Brett Phagan <brett.phagan@nxp.com>

require conf/machine/include/imx6sabresd-common.inc

SOC_FAMILY = "mx6:mx6q"

KERNEL_DEVICETREE = "psi-csim-scm.dtb csim1.dtb imx6dqscm-1gb-qwks-rev3-fix-ldo.dtb imx6dqscm-1gb-qwks-rev3-hdcp-fix-ldo.dtb imx6dqscm-1gb-qwks-rev3-btwifi-fix-ldo.dtb"

UBOOT_CONFIG ??= "sd"
UBOOT_CONFIG[sd] = "csim1_defconfig,sdcard"
UBOOT_CONFIG[mfgtool] = "csim1_defconfig"
UBOOT_CONFIG[spinor] = "mx6dqscm_1gb_fix_qwks_rev3_spinor_defconfig"
```
